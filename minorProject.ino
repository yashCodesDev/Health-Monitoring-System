#include <CircularBuffer.h>
#include <MAX30100.h>
#include <MAX30100_BeatDetector.h>
//#include <MAX30100_Filters.h>
#include <MAX30100_PulseOximeter.h>
#include <MAX30100_Registers.h>
#include <MAX30100_SpO2Calculator.h>
#include <FirebaseESP32.h>
#include <Wire.h>
#include <OneWire.h>
#include <DallasTemperature.h>
#include <Adafruit_GFX.h>
#include <Adafruit_SSD1306.h>

#define OLED_RESET 4
Adafruit_SSD1306 display(128, 64, &Wire, OLED_RESET);

#define REPORTING_PERIOD_MS 10000
#define FIREBASE_HOST "https://charak-b38e5-default-rtdb.firebaseio.com/"
#define FIREBASE_AUTH "k3LUXPK6ELXmiTd5fAbcJoPqh0BNCImLesZdzlqd"

#define WIFI_SSID       "POCO"
#define WIFI_PASSWORD   "Yash1234"

#define ONE_WIRE_BUS 23

OneWire oneWire(ONE_WIRE_BUS);

// Pass our oneWire reference to Dallas Temperature. 
DallasTemperature sensors(&oneWire);

FirebaseData firebaseData;
FirebaseJson json;
//FirebaseFailed failed;
//FirebaseError error;
PulseOximeter pox;


const unsigned char charakCHARAK [] PROGMEM = {
  0xff, 0xff, 0xff, 0xff, 0xff, 0xff, 0xff, 0xff, 0xff, 0xff, 0xff, 0xff, 0xff, 0xff, 0xff, 0xff, 
  0xff, 0xff, 0xff, 0xff, 0xff, 0xff, 0xff, 0xff, 0xff, 0xff, 0xff, 0xff, 0xff, 0xff, 0xff, 0xff, 
  0xff, 0xff, 0xff, 0xff, 0xff, 0xff, 0xff, 0xff, 0xff, 0xff, 0xff, 0xff, 0xff, 0xff, 0xff, 0xff, 
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  0xff, 0xff, 0xff, 0xff, 0xff, 0xff, 0xff, 0xff, 0xff, 0xff, 0xff, 0xff, 0xff, 0xff, 0xff, 0xff
};

// Array of all bitmaps for convenience. (Total bytes used to store images in PROGMEM = 1040)
const int charakallArray_LEN = 1;
const unsigned char* charakallArray[1] = {
  charakCHARAK
};

uint32_t tsLastReport = 0;

void onBeatDetected()
{
    Serial.println("Beat!");
}

void setup()
{   display.begin(SSD1306_SWITCHCAPVCC, 0x3C); //or 0x3C
    Serial.begin(115200);
    pinMode(2, OUTPUT);
    sensors.begin();
    Serial.print("Initializing Pulse Oximeter..");
    pinMode(16, OUTPUT);
    if (!pox.begin())
    {
      Serial.println("FAILED");
      for(;;);
    }
    else
    {
      Serial.println("SUCCESS");
      digitalWrite(2, HIGH);   //Turn off in-built LED
    }
    // Connect to wifi.
    WiFi.begin(WIFI_SSID, WIFI_PASSWORD);
    Serial.print("Connecting");
    while (WiFi.status() != WL_CONNECTED) {
        Serial.print(".");
        delay(500);
    }
    Serial.println();
    Serial.print("Connected with IP: ");
    Serial.println(WiFi.localIP());

    Firebase.begin(FIREBASE_HOST, FIREBASE_AUTH);

    Firebase.set(firebaseData,"HeartBeat", 0);
    Firebase.set(firebaseData,"SpO2", 0);
//
//   if (Firebase.failed()) {
//        Serial.print("setting /message failed:");
//        Serial.println(Firebase.error());
//    }

    pox.begin();
    pox.setOnBeatDetectedCallback(onBeatDetected);
//      pox.setIRLedCurrent(MAX30100_LED_CURR_24MA);
//      pox.setIRLedCurrent(MAX30100_LED_CURR_7_6MA);
  display.clearDisplay(); //for Clearing the display
  display.drawBitmap(0, 0, charakCHARAK, 128, 64, WHITE);//company logo
  display.display();
//  delay(1000);

}

void loop()
{   
//    int count = 0;
//  delay(100);
  pox.update();
  
    if (millis() - tsLastReport > REPORTING_PERIOD_MS) {

        int bpm = pox.getHeartRate();
        float spO2 = pox.getSpO2();
        float tempC = sensors.getTempCByIndex(0);
        
        if (bpm < 50 || spO2 == 0) {                            
          Serial.println(F("low value from sensor!"));
          display.clearDisplay();
          display.setTextColor(SSD1306_WHITE);
          display.setCursor(0,10);
          display.setTextSize(1);
          display.println("PUT YOUR FINGER!");
          display.println("Correctly");
          display.display();
          return;
        }
        
        digitalWrite(2, LOW); 
        if (bpm  > 50 && spO2 != 0) {
        display.clearDisplay();
        display.setTextColor(SSD1306_WHITE);
        display.setTextSize(1);
        Serial.print("Heart rate:");
        display.setCursor(0,0);
        display.println("Heart rate:");
        Serial.print(bpm);
//            display.setCursor(0,20);
        display.println(bpm);
    
        Serial.print("bpm / SpO2:");
        Serial.print(spO2);
//        display.setCursor(20,0);
        display.println("SpO2:");
//        display.setCursor(20,20);
        display.println(spO2);
       
        Serial.println("%");
        Serial.println("TEMPERATURE");
//             display.setCursor(30,0);
        display.println("TEMP");
//         display.setCursor(30,20);
        Serial.println(tempC);
        display.println(tempC);
       
        display.display();
        delay(1000);
        }
        digitalWrite(2, HIGH);
                                       
        tsLastReport = millis();
        sensors.requestTemperatures(); 
        if (bpm != 0) {
            Firebase.setInt(firebaseData,"HeartBeat", bpm);
            Firebase.setInt(firebaseData,"SpO2", spO2);
            Firebase.setInt(firebaseData,"TEMPERATURE",tempC);
        } 
               display.clearDisplay();
              display.println("Sending Data to cloud");
              display.display();
              delay(10000);
        esp_restart();
    }
    pox.update();
}
